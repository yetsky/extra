## packages/coova-chilli/Config.in
```kconfig
# CoovaChilli advanced configuration

menu "Configuration"
	depends on PACKAGE_coova-chilli

config COOVACHILLI_REDIR
	bool "Enable support for redir server. Required for uamregex"
	default n

config COOVACHILLI_MINIPORTAL
	bool "Enable support Coova miniportal"
	default n

config COOVACHILLI_USERAGENT
	bool "Enable recording user-agent"
	default n

config COOVACHILLI_DNSLOG
	bool "Enable support to log DNS name queries"
	default n

config COOVACHILLI_UAMDOMAINFILE
	bool "Enable loading of mass uamdomains from file"
	default n

config COOVACHILLI_LARGELIMITS
	bool "Enable larger limits for use with non-embedded systems"
	default n

config COOVACHILLI_PROXY
	bool "Enable proxy"
	default n

config COOVACHILLI_MINICONFIG
	bool "Enable mini configuration file"
	default n

config COOVACHILLI_BINSTATUSFILE
	bool "Enable binary status file"
	default n

config COOVACHILLI_LAYER3
	bool "Enable Layer 3 mode"
	default n

config COOVACHILLI_DISABLE_LEAKYBUCKET
	bool "Disable use of leaky bucket rate shaping."
	default n

config COOVACHILLI_RTMON
	bool "Enable support for route monitoring deamon (experimental)"
	default n

config COOVACHILLI_CURL
	bool "enable support for curl (optional and used with --enable-chilliproxy)"
	default n

choice
	prompt "SSL library"
	default COOVACHILLI_NOSSL

config COOVACHILLI_NOSSL
	bool "No SSL support"

config COOVACHILLI_MATRIXSSL
	bool "MatrixSSL"

config COOVACHILLI_CYASSL
	bool "CyaSSL"

config COOVACHILLI_OPENSSL
	bool "OpenSSL"

endchoice

endmenu
```

## packages/n2n-v2/Config.in
```kconfig
menu "Configuration"
    depends on PACKAGE_n2n-v2

config CONFIG_N2N_AES_ENCRYPTION
    bool "Use AES Encryption"
    default n

endmenu
```
